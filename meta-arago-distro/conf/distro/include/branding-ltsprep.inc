## meta-arago-distro/conf/distro/include/branding-ltsprep.inc
```bitbake
TI_PREFERRED_BSP = "ti-6_12"

# Remove mmip - DRM allocator, KMS sink, Wayland sink need porting to GST 1.18
MACHINE_FEATURES:remove = "mmip"

# GC320 support requires out-of-tree drivers not available in until LTS prep is
# complete. Disable for now.
MACHINE_FEATURES:remove = "gc320"
```
